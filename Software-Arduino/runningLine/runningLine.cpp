#include "runningLine.h"
#include <string.h>
#include <stdlib.h>
#include <Arduino.h>
#include <SPI.h>

#define SS_PIN 8

static unsigned char numModules = 3;
static const unsigned char numRows = 8;
static const unsigned char numColumns = 8;

static const unsigned char symbolWidth = 5;
static const unsigned char alphabet[][5] = {
  {0x00, 0x00, 0x00, 0x00, 0x00}, // ' '
  {0x00, 0x00, 0xFD, 0x00, 0x00}, // !
  {0x44, 0x02, 0x12, 0x02, 0x44}, // "   <!!!none!!!
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  {0x11, 0x13, 0x15, 0x19, 0x11}  // z
};

static const unsigned char spaceWidth = 1;
static const unsigned char space[] = {0x00};

static unsigned char *alStr = NULL;
static unsigned int strLen;
static unsigned int curIndex = 0;

static const unsigned char *convertChar(char ch)
{
  return alphabet[ch - ' '];
}

static void convertString(char *srcStr)
{
  unsigned int srcStrLen = strlen(srcStr);
  
  strLen = (symbolWidth + spaceWidth) * srcStrLen + (symbolWidth * numModules);
  alStr = (unsigned char*)malloc(srcStrLen * 
       (sizeof(alphabet[0][0]) * symbolWidth + sizeof(space[0]) * spaceWidth) +
       (sizeof(alphabet[0][0]) * numModules));
  
  const unsigned char *buf;
  int offset;
  for (int i = 0; i < srcStrLen; ++i) {
    buf = convertChar(srcStr[i]);
    offset = i * (symbolWidth + spaceWidth);
    for (int j = 0; j < symbolWidth; ++j) {
      *(alStr + offset) = buf[j];
      ++offset;
    }
    for (int j = 0; j < spaceWidth; ++j) {
      *(alStr + offset) = space[j];
      ++offset;
    }
  }
  
  /* Дополнительные пробелы в конце строки */
  buf = convertChar(' ');
  for (int i = 0; i < numModules; ++i) {
    for (int j = 0; j < symbolWidth; ++j) {
      *(alStr + offset) = buf[j];
      ++offset;
    }
    for (int j = 0; j < spaceWidth; ++j) {
      *(alStr + offset) = space[j];
      ++offset;
    }
  }
}

static unsigned char getLetter(unsigned int index)
{
  if (index + curIndex < strLen)
    return alStr[index + curIndex];
  else
    return alStr[index - (strLen - curIndex)];
}

void clearString(void)
{
  if (alStr != NULL)
    free(alStr);
}

void setString(char *str)
{
  clearString();
  convertString(str);
}

void strobe(){
	digitalWrite(SS_PIN,HIGH);
	digitalWrite(SS_PIN,LOW);
}

void shiftString(char diff)
{
  if (alStr == NULL)
    return;
  
  curIndex = (curIndex + diff) % strLen;
}

void printString()
{
  if (alStr == NULL)
    return;
  
  /* Рисует по столбцу в каждом модуле */
  for (int i = 0; i < numColumns; ++i) {
    for (int k = numModules - 1; k >= 0 ; --k) {
      if ((i + k * numColumns) < strLen) {
        SPI.transfer(~getLetter(i + k * numColumns));
        SPI.transfer(0x80 >> i);
      } else {
        SPI.transfer(0x00);
        SPI.transfer(0x00);
      }
    }
    strobe();
    delay(1);
  }
  
  /* Рисует только один столбец */
//  for (int i = 0; i < strLen; ++i) {
//    for (int j = numModules - 1; j >= 0; --j) {
//      /* Если столбец находится в модуле, то рисуем его */
//      if ((i / numColumns) == j) {
//        _txByte(~getLetter(i));
//        _txByte(0x80 >> (i % 8));
//      } else {
//        _txByte(0x00);
//        _txByte(0x00);
//      }
//    }
//    strobe();
////    delay();
//  }
}
